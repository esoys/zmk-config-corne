## boards/shields/corne_choc_pro/Kconfig.defconfig
```kconfig
if SHIELD_CORNE_CHOC_PRO

config ZMK_KEYBOARD_NAME
    default "corne choc pro"

config ZMK_SPLIT_ROLE_CENTRAL
    default y

config ZMK_SPLIT
    default y


config ZMK_SPLIT_BLE_CENTRAL_PERIPHERALS
    default 2

config BT_MAX_CONN
    default 5

config BT_MAX_PAIRED
    default 6

endif
```

## boards/shields/corne_choc_pro/Kconfig.shield
```kconfig
config SHIELD_CORNE_CHOC_PRO
    def_bool $(shields_list_contains, corne_choc_pro)
```

## boards/shields/corne_choc_pro_dongle/Kconfig.defconfig
```kconfig
if SHIELD_CORNE_CHOC_PRO_DONGLE_CENTRAL

config ZMK_KEYBOARD_NAME
    default "Corne Choc Pro"

config ZMK_SPLIT_ROLE_CENTRAL
    default y

config ZMK_SPLIT
    default y


config ZMK_SPLIT_BLE_CENTRAL_PERIPHERALS
    default 2


if SHIELD_CORNE_CHOC_PRO_DONGLE_PERIPHERAL_LEFT || SHIELD_CORNE_CHOC_PRO_DONGLE_PERIPHERAL_RIGHT

config ZMK_SPLIT_ROLE_CENTRAL
    default n

config ZMK_SPLIT
    default y

endif

endif
```
